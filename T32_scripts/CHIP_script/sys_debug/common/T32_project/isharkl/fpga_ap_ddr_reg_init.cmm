D.S 0xe42b0130 %LONG 0x00010000
D.S 0xe42b00d0 %LONG 0x00000007
D.S 0xe42b00d0 %LONG 0x00001d07
D.S 0xe42b00d0 %LONG 0x00000507
D.S 0xc0010238 %LONG 0x48484848
D.S 0xc001023c %LONG 0x00000048
D.S 0xc00001b0 %LONG 0x00000000
D.S 0xc0000320 %LONG 0x00000000
wait 0.1s
D.S 0xc0000320 %LONG 0x00000001
D.S 0xc0000000 %LONG 0x03020004
D.S 0xc00000d0 %LONG 0x00020002
D.S 0xc00000d4 %LONG 0x0002080d
D.S 0xc00000d8 %LONG 0x00000e06
D.S 0xc00000dc %LONG 0x00c20006
D.S 0xc00000e0 %LONG 0x00020000
D.S 0xc00000e4 %LONG 0x00110006
D.S 0xc00000f0 %LONG 0x00000000
D.S 0xc00000f4 %LONG 0x00000663
D.S 0xc0000100 %LONG 0x111b7f17
D.S 0xc0000104 %LONG 0x00040420
D.S 0xc0000108 %LONG 0x04080b0b
D.S 0xc000010c %LONG 0x00502000
D.S 0xc0000110 %LONG 0x0a04060a
D.S 0xc0000114 %LONG 0x02020803
D.S 0xc0000118 %LONG 0x02020006
D.S 0xc000011c %LONG 0x00000202
D.S 0xc0000120 %LONG 0x00000303
D.S 0xc0000034 %LONG 0x00000008
D.S 0xc0000064 %LONG 0x00620038
D.S 0xc0000038 %LONG 0x00100003
D.S 0xc0000188 %LONG 0x00000000
D.S 0xc0000190 %LONG 0x08060002
D.S 0xc0000194 %LONG 0x00030204
D.S 0xc0000198 %LONG 0x0a00f100
D.S 0xc00001a0 %LONG 0x80400003
D.S 0xc00001a4 %LONG 0x001a0021
D.S 0xc00001a8 %LONG 0x026904c9
D.S 0xc00001ac %LONG 0x030e051f
D.S 0xc0000200 %LONG 0x00001f14
D.S 0xc0000204 %LONG 0x00070707
D.S 0xc0000208 %LONG 0x00000000
D.S 0xc000020c %LONG 0x00000000
D.S 0xc0000210 %LONG 0x00000f0f
D.S 0xc0000214 %LONG 0x06060606
D.S 0xc0000218 %LONG 0x0f0f0606
D.S 0xc0000244 %LONG 0x00000000
D.S 0xc0000250 %LONG 0x00070c01
D.S 0xc0000258 %LONG 0x00000000
D.S 0xc000025c %LONG 0x10000000
D.S 0xc0000260 %LONG 0x00000100
D.S 0xc0000264 %LONG 0x40000100
D.S 0xc0000268 %LONG 0x00000000
D.S 0xc000026c %LONG 0x10000000
D.S 0xc0000400 %LONG 0x00000011
D.S 0xc0000404 %LONG 0x0001f000
D.S 0xc0000408 %LONG 0x00004005
D.S 0xc0000490 %LONG 0x00000001
D.S 0xc00004b4 %LONG 0x0001f000
D.S 0xc00004b8 %LONG 0x00004005
D.S 0xc0000540 %LONG 0x00000001
D.S 0xc0000564 %LONG 0x0001f000
D.S 0xc0000568 %LONG 0x00004005
D.S 0xc00005f0 %LONG 0x00000001
D.S 0xc0000614 %LONG 0x0001f000
D.S 0xc0000618 %LONG 0x00004005
D.S 0xc00006a0 %LONG 0x00000001
D.S 0xc00006c4 %LONG 0x0001f000
D.S 0xc00006c8 %LONG 0x00004005
D.S 0xc0000750 %LONG 0x00000001
D.S 0xc0000774 %LONG 0x0001f000
D.S 0xc0000778 %LONG 0x00004005
D.S 0xc0000800 %LONG 0x00000001
D.S 0xc0000824 %LONG 0x0001f000
D.S 0xc0000828 %LONG 0x00004005
D.S 0xc00008b0 %LONG 0x00000001
D.S 0xc00008d4 %LONG 0x0001f000
D.S 0xc00008d8 %LONG 0x00004005
D.S 0xc0000960 %LONG 0x00000001
D.S 0xc0000984 %LONG 0x0001f000
D.S 0xc0000988 %LONG 0x00004005
D.S 0xc0000a10 %LONG 0x00000001
D.S 0xc0000a34 %LONG 0x0001f000
D.S 0xc0000a38 %LONG 0x00004005
D.S 0xc0000ac0 %LONG 0x00000001
D.S 0xc00100b4 %LONG 0x71fff3f0
D.S 0xc0010024 %LONG 0x05002b54
D.S 0xc0010028 %LONG 0x00820020
D.S 0xc001002c %LONG 0x00041084
D.S 0xc0010014 %LONG 0xc0aa0060
D.S 0xc0010020 %LONG 0x01000003
D.S 0xc0010084 %LONG 0x0028649f
D.S 0xc0010088 %LONG 0x00000408
D.S 0xc001009c %LONG 0x00000000
D.S 0xc00100a0 %LONG 0x000000c2
D.S 0xc00100a4 %LONG 0x00000006
D.S 0xc00100a8 %LONG 0x00000002
D.S 0xc001008c %LONG 0x85978a44
D.S 0xc0010090 %LONG 0x22823372
D.S 0xc0010094 %LONG 0x0401a0c8
D.S 0xc0010098 %LONG 0x00000019
D.S 0xc0010080 %LONG 0x00181884
D.S 0xc001000c %LONG 0x0380c7a0
D.S 0xc0010280 %LONG 0x3c000285
D.S 0xc0010300 %LONG 0x3c000285
D.S 0xc0010380 %LONG 0x3c000285
D.S 0xc0010400 %LONG 0x3c000285
D.S 0xc0010014 %LONG 0xc0aafe60
D.S 0xe42b00d0 %LONG 0x00000007
wait 0.1s
D.S 0xc0010004 %LONG 0x60040001
wait 0.1s
D.S 0xc00001b0 %LONG 0x00000001
D.S 0xe42b0130 %LONG 0x00000000
wait 1s
D.S 0xc00102a4 %LONG 0x001a0000
D.S 0xc0010324 %LONG 0x001a0000
D.S 0xc00103a4 %LONG 0x001a0000
D.S 0xc0010424 %LONG 0x001a0000
D.S 0xc00100b0 %LONG 0x93043001
D.S 0xc0010004 %LONG 0x60040401
wait 1s
D.S 0xc0000014 %LONG 0x00000800
D.S 0xc0000010 %LONG 0x80000011
D.S 0xc0000030 %LONG 0x0000000a
D.S 0xe42b00f8 %LONG 0xc3ff03ff
D.S 0xe42b012c %LONG 0x1a040203
D.S 0xe42b0130 %LONG 0x00000001
D.S 0xc00001b0 %LONG 0x00000000
