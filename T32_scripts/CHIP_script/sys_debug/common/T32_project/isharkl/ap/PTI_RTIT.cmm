IF (CPUFAMILY()!="I386")
(
	PRINT %ERROR "Please open the right Trace32!"
	ENDDO
)

SYStem.CONFIG STM1.Mode STP64
Trace.METHOD Analyzer
Trace.THreshold 0.9
Trace.Init
STM.PortSize 8

; PTI Enable, 8BIT
D.S AND:0xF0009000 %LE %Long 0x00002524
; PTI Enable, 16BIT
;D.S AND:0xF0009000 %LE %Long 0x00002544
; PTI Enable, 32BIT
;D.S AND:0xF0009000 %LE %Long 0x00002534

Trace.Arm
LOCAL &PTI_STM_SW_BASE &MASTER_ID &CHANNEL_ID &GTS &PTI_STM_SW_ADDR
LOCAL &MASTER_ID_BIT &CHANNEL_ID_BIT &GTS_BIT
&PTI_STM_SW_BASE=0xF4800000
&MASTER_ID_BIT=15.
&CHANNEL_ID_BIT=8.
&GTS_BIT=6.

&GTS=0.
&MASTER_ID=0.
&CHANNEL_ID=0.
WHILE (&GTS<3.)
(
	GOSUB PTI_STM_SW_TEST
	&GTS=&GTS+1
)

&GTS=0.
&MASTER_ID=0.
&CHANNEL_ID=0.
WHILE (&CHANNEL_ID<128.)
(
	GOSUB PTI_STM_SW_TEST
	&CHANNEL_ID=&CHANNEL_ID+1
)

&GTS=0.
&MASTER_ID=0.
&CHANNEL_ID=0.

WHILE (&MASTER_ID<128.)
(
	GOSUB PTI_STM_SW_TEST
	&MASTER_ID=&MASTER_ID+1
)



Trace.OFF
Trace.List

ENDDO

PTI_STM_SW_LOG:
	LOCAL &LOG_MSG
	ENTRY &LOG_MSG
	D.S AND:&PTI_STM_SW_BASE %LE %Quad &LOG_MSG
	RETURN
;END PTI_STM_SW_LOG

PTI_STM_SW_TEST:
	&PTI_STM_SW_ADDR=&PTI_STM_SW_BASE+(&MASTER_ID<<&MASTER_ID_BIT)+(&CHANNEL_ID<<&CHANNEL_ID_BIT)+(&GTS<<&GTS_BIT)
	GOSUB PTI_STM_SW_LOG &PTI_STM_SW_ADDR
	D.S AND:&PTI_STM_SW_ADDR %LE %Quad 0xA5A5A5A5A5A5A5A5
	WAIT 10.MS
	D.S AND:&PTI_STM_SW_ADDR %LE %Quad 0xF0F0F0F0F0F0F0F0
	WAIT 10.MS
	D.S AND:&PTI_STM_SW_ADDR %LE %Quad 0xFFFFFFFFFFFFFFFF
	WAIT 10.MS
	D.S AND:&PTI_STM_SW_ADDR %LE %Quad 0x5A5A5A5A5A5A5A5A
	WAIT 10.MS
	RETURN
;END PTI_STM_SW_TEST