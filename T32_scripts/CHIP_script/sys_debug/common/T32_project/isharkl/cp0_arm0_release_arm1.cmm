LOCAL &MEM_TYPE
IF (CPUFAMILY()=="ARM")
(
	&MEM_TYPE="SD"
	;SYStem.Mode Prepare
)
ELSE IF (CPUFAMILY()=="I386")
(
	PRINT %ERROR "The Trace32 can't do this! open ARM version please!"
)

LOCAL &IS_RUN

D.S &MEM_TYPE:0x20100014 %LE %LONG 0x00000010
GOSUB DETECT_CORE_IS_RUNING 0x10000030 0xFAF5A5A5 0x10000040 0xA5A5FAF5
ENTRY &IS_RUN
IF (&IS_RUN!=1)
(
	;GOSUB SET_WHILE_1 0x10000000
	GOSUB SET_DETECT_CORE_IS_RUNING 0x10000000 0x30 0xFAF5A5A5 0x40 0xA5A5FAF5
	;release reset cp0 arm1
	D.S &MEM_TYPE:0x20100014 %LE %LONG 0x00000000
	WAIT 10.MS
	D.S &MEM_TYPE:0x20100014 %LE %LONG 0x00000010

	GOSUB DETECT_CORE_IS_RUNING 0x10000030 0xFAF5A5A5 0x10000040 0xA5A5FAF5
	ENTRY &IS_RUN
	IF (&IS_RUN==1)
	(
		PRINT "CP0 ARM1 Running"
		;release reset cp0 arm1
		D.S &MEM_TYPE:0x20100014 %LE %LONG 0x00000000
	)
	ELSE
	(
		PRINT "CP0 ARM1 Maybe NOT Running"
	)
)
ELSE
(
	PRINT "CP0 ARM1 already Running"
)
ENDDO

SET_DETECT_CORE_IS_RUNING:
	LOCAL &ADDR &TEST_A1 &TEST_V1 &TEST_A2 &TEST_V2
	ENTRY &ADDR &TEST_A1 &TEST_V1 &TEST_A2 &TEST_V2
	
	D.S &MEM_TYPE:(&ADDR+0x0000) %LE %LONG 0xE59F001C
	D.S &MEM_TYPE:(&ADDR+0x0004) %LE %LONG 0xE59F101C
	D.S &MEM_TYPE:(&ADDR+0x0008) %LE %LONG 0xE5801000
	D.S &MEM_TYPE:(&ADDR+0x000C) %LE %LONG 0xE59F0008
	D.S &MEM_TYPE:(&ADDR+0x0010) %LE %LONG 0xE59F1008
	D.S &MEM_TYPE:(&ADDR+0x0014) %LE %LONG 0xE5801000
	D.S &MEM_TYPE:(&ADDR+0x0018) %LE %LONG 0xEAFFFFFE
	D.S &MEM_TYPE:(&ADDR+0x001C) %LE %LONG &TEST_A1
	D.S &MEM_TYPE:(&ADDR+0x0020) %LE %LONG &TEST_V1
	D.S &MEM_TYPE:(&ADDR+0x0024) %LE %LONG &TEST_A2
	D.S &MEM_TYPE:(&ADDR+0x0028) %LE %LONG &TEST_V2
	RETURN
;END SET_DETECT_CORE_IS_RUNING

DETECT_CORE_IS_RUNING:
	LOCAL &TEST_A1 &TEST_V1 &TEST_A2 &TEST_V2 &READ_V1 &READ_V2 &RET
	ENTRY &TEST_A1 &TEST_V1 &TEST_A2 &TEST_V2
	&READ_V1=DATA.LONG(&MEM_TYPE:&TEST_A1)
	&READ_V2=DATA.LONG(&MEM_TYPE:&TEST_A2)
	&RET=0
	IF (&READ_V1==&TEST_V1)
	(
		&RET=1
	)
	IF (&READ_V2==&TEST_V2)
	(
		&RET=1
	)
	RETURN &RET
;END DETECT_CORE_IS_RUNING

SET_WHILE_1:
	LOCAL &ADDR
	ENTRY &ADDR
	D.S &MEM_TYPE:&ADDR %LE %LONG 0xEAFFFFFE
	RETURN
;END SET_WHILE_1
