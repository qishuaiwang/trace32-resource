; by Ken.Kuang
LOCAL &AHB_PORT
ENTRY &AHB_PORT

IF "X&target"=="X"
(
	&target="CHIP"
	;&target="FPGA"
	;&target="PXP"
)

IF "X&AHB_PORT"=="X"
(
	&AHB_PORT=3.
)

IF "X&os_sel"=="X"
(
	&os_sel="small_sys"
)

LOCAL &CUR_DIR
&CUR_DIR=OS.PPD()

IF (CPUFAMILY()!="ARM")
(
	PRINT %ERROR "Please open the right Trace32!"
	ENDDO
)
SYStem.Mode Down
SYStem.RESet

SYStem.CPU CORTEXM4

ON ERROR CONTinue
IF "&target"=="FPGA"
	SYStem.JtagClock 5MHz
ELSE IF "&target"=="PXP"
	SYStem.JtagClock 150KHz
ELSE
	SYStem.JtagClock 20MHz
ON ERROR

SYStem.CONFIG MEMORYACCESSPORT &AHB_PORT
SYStem.CONFIG DEBUGACCESSPORT 1.

SYStem.CONFIG AXIACCESSPORT   0.
SYStem.CONFIG APBACCESSPORT   1.
SYStem.CONFIG AHBACCESSPORT   3.
SYStem.MemAccess.DAP

ON ERROR CONTinue
SYStem.CONFIG SWDP ON
ON ERROR
SYStem.CONFIG SWDPTargetSel 0x0
ON ERROR GOTO JTAG_Config
SYStem.Mode.Prepare
ON ERROR
GOTO SWD_Config
JTAG_Config:
ON ERROR CONTinue
SYStem.CONFIG SWDP OFF
ON ERROR
ON ERROR GOTO ERROR_Handle
SYStem.DETECT DaisyChain
SYStem.Mode.Prepare
ON ERROR
SWD_Config:

IF ("&os_sel"=="os_sys")
(

	;GOSUB WCN_DEBUG_PD_EN
	WAIT 1.MS
	PRINT "Trace32 Prepared!"
	;SYStem.Mode.Attach
)
ELSE
(
	GOSUB BOOT
	;GOSUB WCN_DEBUG_PD_EN
	WAIT 500.MS
	SYStem.Mode Attach
	Break
)

ENDDO

BOOT:
	DO "&CUR_DIR\boot_all.cmm" CM4_BOOT &AHB_PORT
	RETURN
; end of BOOT

WCN_DEBUG_PD_EN:
	IF (&AHB_PORT!=3)
	(
		; SharkLE ***MUST*** force on MM SYS for WCN Debug!!!
		; MM SYS force on
		D.S EZAXI:0x402B001C+0x2000 %LE %Long 0x3<<24. 
	)
	RETURN
; end of WCN_DEBUG_PD_EN

ERROR_Handle:
	ON ERROR
	IF STATE.POWER()==FALSE()
	(
		PRINT %ERROR "Please Power up device, and then, try it again!"
	)
	ELSE
	(
		PRINT %ERROR "Maybe Hardware Error!"
	)
	ENDDO
