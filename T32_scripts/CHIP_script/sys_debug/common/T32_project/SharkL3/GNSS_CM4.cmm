; by Ken.Kuang

LOCAL &CUR_DIR
&CUR_DIR=OS.PPD()

DO "&CUR_DIR/CM4.cmm" 5