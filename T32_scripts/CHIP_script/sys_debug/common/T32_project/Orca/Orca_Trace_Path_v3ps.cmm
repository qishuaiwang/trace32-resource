ENTRY &trace_output

DO "&CUR_DIR/Orca_Trace_Path_config.cmm"

;plist
;stop

SYStem.CONFIG.COREDEBUG.Base (&v3ps_coredebug_base)
;	SYStem.CONFIG.BMC.Base (&v3ps_pmu_base)
SYStem.CONFIG.CTI.Base (&v3ps_cti_base)
SYStem.CONFIG.ETM.Base (&v3ps_etm_base)

; V3PS
SYStem.CONFIG.FUNNEL2.Base &v3_funnel
SYStem.CONFIG.ETF2.Base &v3ps_etf

; connect trace path
SYStem.CONFIG.ETF2.ATBSource ETM
SYStem.CONFIG.FUNNEL2.ATBSource ETF2 0

;config replicator, soc, etc
DO "&CUR_DIR/Orca_Trace_Path_common.cmm" &trace_output FUNNEL2 2 ETF2

ENDDO
