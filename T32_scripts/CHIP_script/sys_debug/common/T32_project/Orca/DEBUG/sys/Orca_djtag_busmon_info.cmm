;***************************BUSMON REG INFO*********************************
Var.NEWGLOBAL char[33][20] \busmon_regname
Var.set \busmon_regname[0]="CHN_INT"
Var.set \busmon_regname[1]="CHN_CFG"
Var.set \busmon_regname[2]="ID_CFG"
Var.set \busmon_regname[3]="ADDR_MIN"
Var.set \busmon_regname[4]="ADDR_MIN_H32"
Var.set \busmon_regname[5]="ADDR_MAX"
Var.set \busmon_regname[6]="ADDR_MAX_H32"
Var.set \busmon_regname[7]="ADDR_MASK"
Var.set \busmon_regname[8]="ADDR_MASK_H32"
Var.set \busmon_regname[9]="DATA_MIN_L32"
Var.set \busmon_regname[10]="DATA_MIN_H32"
Var.set \busmon_regname[11]="DATA_MIN_EXT_L32"
Var.set \busmon_regname[12]="DATA_MIN_EXT_H32"
Var.set \busmon_regname[13]="DATA_MAX_L32"
Var.set \busmon_regname[14]="DATA_MAX_H32"
Var.set \busmon_regname[15]="DATA_MAX_EXT_L32"
Var.set \busmon_regname[16]="DATA_MAX_EXT_H32"
Var.set \busmon_regname[17]="DATA_MASK_L32"
Var.set \busmon_regname[18]="DATA_MASK_H32"
Var.set \busmon_regname[19]="DATA_MASK_EXT_L32"
Var.set \busmon_regname[20]="DATA_MASK_EXT_H32"
Var.set \busmon_regname[21]="MON_TRANS_LEN"
Var.set \busmon_regname[22]="MATCH_ID"
Var.set \busmon_regname[23]="MATCH_ADDR"
Var.set \busmon_regname[24]="MATCH_ADDR_H32"
Var.set \busmon_regname[25]="MATCH_CMD"
Var.set \busmon_regname[26]="MATCH_DATA_L32"
Var.set \busmon_regname[27]="MATCH_DATA_H32"
Var.set \busmon_regname[28]="MATCH_DATA_EXT_L32"
Var.set \busmon_regname[29]="MATCH_DATA_EXT_H32"
Var.set \busmon_regname[30]="BUS_STATUS"
Var.set \busmon_regname[31]="USER_CFG"
Var.set \busmon_regname[32]="MATCH_USER"

;***************************SYS INFO****************************************
;sys_num means the number of subsys
Var.NEWGLOBAL int \sys_num
Var.set \sys_num=8

;sys_name array includes different name of every subsys
;sys_name[x] is subsys name, 'x' is djtag_dap_sel[15:8] of the sys, please refer to 'DJTAG SPEC' for the project
Var.NEWGLOBAL char[8][6] \sys_name
Var.set \sys_name[0]="AP"
Var.set \sys_name[1]="APCPU"
Var.set \sys_name[2]="PSCP"
Var.set \sys_name[3]="V3"
Var.set \sys_name[4]="NRCP"
Var.set \sys_name[5]="AUDCP"
Var.set \sys_name[6]="PUB"
Var.set \sys_name[7]="AON"

;BUSMON IN AP
;there's none busmon in the subsys, please descript it like below
;'x' in busmon_sysx below is the same as 'x' in sys_name[x], "N/A" means none busmon
Var.NEWGLOBAL char[14][20] \busmon_sys0
Var.set \busmon_sys0[0]="DMA_dap1"
Var.set \busmon_sys0[1]="SDIO_MST_dap2"
Var.set \busmon_sys0[2]="NANDC_dap3"
Var.set \busmon_sys0[3]="EMMC_dap4"
Var.set \busmon_sys0[4]="USB3_0_dap5"
Var.set \busmon_sys0[5]="TO_AON_dap6"
Var.set \busmon_sys0[6]="IPA_dap7"
Var.set \busmon_sys0[7]="TFT_dap8"
Var.set \busmon_sys0[8]="SDIO_SLV_dap9"
Var.set \busmon_sys0[9]="USB_PAM_dap10"
Var.set \busmon_sys0[10]="USB3_1_dap11"
Var.set \busmon_sys0[11]="PCIE_MSTR_dap12"
Var.set \busmon_sys0[12]="PAM_WIFI_dap13"
Var.set \busmon_sys0[13]="TO_DDR_dap14"

;BUSMON IN APCPU
Var.NEWGLOBAL char[2][10] \busmon_sys1
Var.set \busmon_sys1[0]="DSU_dap1"
Var.set \busmon_sys1[1]="ETR_dap2"

;BUSMON IN PSCP
Var.NEWGLOBAL char[14][20] \busmon_sys2
Var.set \busmon_sys2[0]="L2_CACHE_dap0"
Var.set \busmon_sys2[1]="LLPP_dap1"
Var.set \busmon_sys2[2]="FPP0_dap2"
Var.set \busmon_sys2[3]="FPP1_dap3"
Var.set \busmon_sys2[4]="V3_SEC_dap4"
Var.set \busmon_sys2[5]="DMA_LINK0_dap5"
Var.set \busmon_sys2[6]="DMA_LINK_4C_dap6"
Var.set \busmon_sys2[7]="DMA_dap7"
Var.set \busmon_sys2[8]="SDIO_dap8"
Var.set \busmon_sys2[9]="NR_SEC0_dap9"
Var.set \busmon_sys2[10]="NR_SEC1_dap10"
Var.set \busmon_sys2[11]="FROM_AP_dap11"
Var.set \busmon_sys2[12]="FROM_NR_dap12"
Var.set \busmon_sys2[13]="TO_DDR_dap13"

;BUSMON IN V3
Var.NEWGLOBAL char[16][30] \busmon_sys3
Var.set \busmon_sys3[0]="PHY_CR5_L2_CACHE_dap1"
Var.set \busmon_sys3[1]="PHY_DMA_dap2"
Var.set \busmon_sys3[2]="PHY_DMA_LINK_dap3"
Var.set \busmon_sys3[3]="PS_dap4"
Var.set \busmon_sys3[4]="LW_dap5"
Var.set \busmon_sys3[5]="PHY_CR5_LLPP_dap6"
Var.set \busmon_sys3[6]="PS_CR5_L2_CACHE_dap7"
Var.set \busmon_sys3[7]="PS_SEC_dap8"
Var.set \busmon_sys3[8]="PS_TFT_dap9"
Var.set \busmon_sys3[9]="PS_DMA_LINK0_dap10"
Var.set \busmon_sys3[10]="PS_DMA_LINK_4C_dap11"
Var.set \busmon_sys3[11]="PS_DMA_dap12"
Var.set \busmon_sys3[12]="PS_SDIO_dap13"
Var.set \busmon_sys3[13]="PS_CR5_LLPP_dap14"
Var.set \busmon_sys3[14]="LW_HARQBUF_dap15"
Var.set \busmon_sys3[15]="LW_TO_DDR_dap16"

;BUSMON IN NRCP
Var.NEWGLOBAL char[14][30] \busmon_sys4
Var.set \busmon_sys4[0]="CR8_L2_CACHE_dap1"
Var.set \busmon_sys4[1]="_CR8_LLPP_dap2"
Var.set \busmon_sys4[2]="CR8_FPP0_dap3"
Var.set \busmon_sys4[3]="CR8_FPP1_dap4"
Var.set \busmon_sys4[4]="DMA_dap5"
Var.set \busmon_sys4[5]="NR_SEC_dap6"
Var.set \busmon_sys4[6]="NR_UL_dap7"
Var.set \busmon_sys4[7]="NR_DL_dap8"
Var.set \busmon_sys4[8]="NR_SYNC_dap9"
Var.set \busmon_sys4[9]="NR_SYNC_dap10"
Var.set \busmon_sys4[10]="NR_SYNC_dap11"
Var.set \busmon_sys4[11]="NR_SYNC_dap12"
Var.set \busmon_sys4[12]="NR_SYNC_dap13"
Var.set \busmon_sys4[13]="NR_SYNC_dap14"

;BUSMON IN AUDCP
;\busmon_sys5[x] is the 'x'th busmon name, please name it like XXXX_dapy, and 'y' is equal to djtag_dap_sel[7:0]
Var.NEWGLOBAL char[4][22] \busmon_sys5
Var.set \busmon_sys5[0]="AUDDSP_D_dap0"
Var.set \busmon_sys5[1]="DMA_AP_dap1"
Var.set \busmon_sys5[2]="DMA_CP_dap2"
Var.set \busmon_sys5[3]="FROM_AON_dap3"

;BUSMON IN PUB
Var.NEWGLOBAL char[1][5] \busmon_sys6
Var.set \busmon_sys6[0]="N/A"

;BUSMON IN AON
;\busmon_sys7[x] is the 'x'th busmon name, please name it like XXXX_dapy, and 'y' is equal to djtag_dap_sel[7:0]
Var.NEWGLOBAL char[8][15] \busmon_sys7
Var.set \busmon_sys7[0]="AP_dap0"
Var.set \busmon_sys7[1]="v3_dap1"
Var.set \busmon_sys7[2]="AUDCP_dap2"
Var.set \busmon_sys7[3]="PUBCP_dap3"
Var.set \busmon_sys7[4]="NRCP_dap4"
Var.set \busmon_sys7[5]="CM4_dap5"
Var.set \busmon_sys7[6]="DAP_dap6"
Var.set \busmon_sys7[7]="ETR_dap7"

ENDDO