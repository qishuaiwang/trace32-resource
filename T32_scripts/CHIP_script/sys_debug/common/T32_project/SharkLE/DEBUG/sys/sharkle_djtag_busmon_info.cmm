;***************************BUSMON REG INFO*********************************
Var.NEWGLOBAL char[33][20] \busmon_regname
Var.set \busmon_regname[0]="CHN_INT"
Var.set \busmon_regname[1]="CHN_CFG"
Var.set \busmon_regname[2]="ID_CFG"
Var.set \busmon_regname[3]="ADDR_MIN"
Var.set \busmon_regname[4]="ADDR_MIN_H32"
Var.set \busmon_regname[5]="ADDR_MAX"
Var.set \busmon_regname[6]="ADDR_MAX_H32"
Var.set \busmon_regname[7]="ADDR_MASK"
Var.set \busmon_regname[8]="ADDR_MASK_H32"
Var.set \busmon_regname[9]="DATA_MIN_L32"
Var.set \busmon_regname[10]="DATA_MIN_H32"
Var.set \busmon_regname[11]="DATA_MIN_EXT_L32"
Var.set \busmon_regname[12]="DATA_MIN_EXT_H32"
Var.set \busmon_regname[13]="DATA_MAX_L32"
Var.set \busmon_regname[14]="DATA_MAX_H32"
Var.set \busmon_regname[15]="DATA_MAX_EXT_L32"
Var.set \busmon_regname[16]="DATA_MAX_EXT_H32"
Var.set \busmon_regname[17]="DATA_MASK_L32"
Var.set \busmon_regname[18]="DATA_MASK_H32"
Var.set \busmon_regname[19]="DATA_MASK_EXT_L32"
Var.set \busmon_regname[20]="DATA_MASK_EXT_H32"
Var.set \busmon_regname[21]="MON_TRANS_LEN"
Var.set \busmon_regname[22]="MATCH_ID"
Var.set \busmon_regname[23]="MATCH_ADDR"
Var.set \busmon_regname[24]="MATCH_ADDR_H32"
Var.set \busmon_regname[25]="MATCH_CMD"
Var.set \busmon_regname[26]="MATCH_DATA_L32"
Var.set \busmon_regname[27]="MATCH_DATA_H32"
Var.set \busmon_regname[28]="MATCH_DATA_EXT_L32"
Var.set \busmon_regname[29]="MATCH_DATA_EXT_H32"
Var.set \busmon_regname[30]="BUS_STATUS"
Var.set \busmon_regname[31]="USER_CFG"
Var.set \busmon_regname[32]="MATCH_USER"

;***************************SYS INFO****************************************
Var.NEWGLOBAL int \sys_num
Var.set \sys_num=10

Var.NEWGLOBAL char[10][6] \sys_name
Var.set \sys_name[0]="AP"
Var.set \sys_name[1]="MM"
Var.set \sys_name[2]="GPU"
Var.set \sys_name[3]="AON"
Var.set \sys_name[4]="PUB"
Var.set \sys_name[5]="WTLCP"
Var.set \sys_name[6]="PUBCP"
Var.set \sys_name[9]="WCN"

;BUSMON IN AP
Var.NEWGLOBAL char[1][5] \busmon_sys0
Var.set \busmon_sys0[0]="N/A"

;BUSMON IN MM
Var.NEWGLOBAL char[1][5] \busmon_sys1
Var.set \busmon_sys1[0]="N/A"

;BUSMON IN GPU
Var.NEWGLOBAL char[1][5] \busmon_sys2
Var.set \busmon_sys2[0]="N/A"

;BUSMON IN AON
Var.NEWGLOBAL char[4][15] \busmon_sys3
Var.set \busmon_sys3[0]="AP_dap1"
Var.set \busmon_sys3[1]="WTLCP_dap2"
Var.set \busmon_sys3[2]="PUBCP_dap3"
Var.set \busmon_sys3[3]="WCN_dap4"

;BUSMON IN PUB
Var.NEWGLOBAL char[1][5] \busmon_sys4
Var.set \busmon_sys4[0]="N/A"

;BUSMON IN WTLCP
Var.NEWGLOBAL char[7][22] \busmon_sys5
Var.set \busmon_sys5[0]="LTE_DSP_D_dap2"
Var.set \busmon_sys5[1]="TG_DSP_D_dap4"
Var.set \busmon_sys5[2]="LTE_DMA_dap5"
Var.set \busmon_sys5[3]="TG_DMA_dap6"
Var.set \busmon_sys5[4]="LACCX2LDSPX_dap8"
Var.set \busmon_sys5[5]="WCDMA_DMA1_dap49"
Var.set \busmon_sys5[6]="WCDMA_PCPW_dap50"

;BUSMON IN PUBCP
Var.NEWGLOBAL char[1][5] \busmon_sys6
Var.set \busmon_sys6[0]="N/A"

;BUSMON IN WCN
Var.NEWGLOBAL char[1][5] \busmon_sys9
Var.set \busmon_sys9[0]="N/A"

ENDDO