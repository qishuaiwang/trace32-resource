local &CUR_DIR
&CUR_DIR=OS.PPD()
D.LOAD "&CUR_DIR\u-boot-spl"

GO 0x50013FD8
WAIT !RUN()
D.TEST 0x80000000++0xfff /RANDOM
IF FOUND()
	PRINT "DDR INIT Failed!"
ELSE
	PRINT "DDR INIT OK!"
ENDDO



