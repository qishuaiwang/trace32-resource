; by Ken.Kuang

IF "X&os_sel"=="X"
(
	&os_sel="small_sys"
)

LOCAL &CUR_DIR
&CUR_DIR=OS.PPD()

SYStem.Mode Down
SYStem.RESet

SYStem.CPU ARM7TDMI
;SYStem.CONFIG CoreNumber 1
;CORE.ASSIGN 1
SYStem.JtagClock 20MHz


IF ("&os_sel"=="os_sys")
(
	SYStem.Option EnReset off
)

TrOnchip.Set RESET OFF
TrOnchip.Set UNDEF OFF
TrOnchip.Set DABORT OFF
TrOnchip.Set PABORT OFF

SYStem.CONFIG JTAGACCESSPORT 2
SYStem.CONFIG COREJTAGPORT 3 ; ARM7 3 ; LDSP 1 ; TGDSP 2

SYStem.CONFIG MEMORYACCESSPORT 0
SYStem.CONFIG DEBUGACCESSPORT 1
SYStem.CONFIG AXIACCESSPORT 0
SYStem.CONFIG AHBACCESSPORT 0xFF
SYStem.CONFIG APBACCESSPORT 1

SYStem.CONFIG SWDP ON
SYStem.CpuAccess Enable
SYStem.MemAccess DAP
SYStem.Mode.Prepare


IF ("&os_sel"=="os_sys")
(
	PRINT "Trace32 Prepared!"
	;SYStem.Mode.Attach
)
ELSE
(
	GOSUB BOOT
	SYStem.Mode Attach
	Break
)

ENDDO

BOOT:
	DO "&CUR_DIR\boot_all.cmm" ARM7_BOOT
	RETURN
; end of BOOT
