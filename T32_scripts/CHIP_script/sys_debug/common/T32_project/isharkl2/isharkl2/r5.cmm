;please add cmm script brfore ENDDO
GLOBAL &CONFIG_INPUT &RESET_INPUT &SIGNAL_INPUT &PROBE_MODE_INPUT &RTIT_INPUT &DST_DIR &os_sel
LOCAL &core_flags &temp &jtag_clk &wka_flag &sys_sel
ENTRY &core_flags &sys_sel
IF "X&os_sel"=="X"
(
	&os_sel="small_sys"
)
IF "X&sys_sel"=="X"
(
	&sys_sel="&os_sel"
)
IF "X&CONFIG_INPUT"=="X"
(
	&CONFIG_INPUT="DAP"
)
IF (CPUFAMILY()!="ARM")
(
	PRINT %ERROR "Please open the right Trace32!"
	ENDDO
)
LOCAL &slave_flag
&slave_flag=SYStem.CONFIG.Slave()
system.mode down
;system.reset
sys.Option EnReset OFF
sys.Option TRST OFF

system.jtagclock 20.Mhz

system.cpu CORTEXR5
;IF (&slave_flag==False())
;(
	;SYStem.CONFIG.Slave ON
	jtag.pin.ntrst 1
;)
 
;system.config CORENUMBER 1.
;core.assign 1
;SYStem.Option intelsoc ON
;SYStem.CONFIG slave on
sys.config corebase 		 0x80030000
SYS.CONFIG CTIBase       0x80038000
sys.config etmbase       0x8003c000
SYStem.CONFIG.STM1.Base 0x80006000
SYStem.CONFIG.STM1.Type ARM
SYStem.CONFIG.STM1.Mode STPv2
SYStem.CONFIG.FUNNEL1.Base 0x80001000
SYStem.CONFIG.ETB1.Base 0x80003000
SYStem.CONFIG.FUNNEL1.ATBSource STM1 1
SYStem.CONFIG.ETB1.ATBSource FUNNEL1

;system.multiCore JTAGACCESSPORT 2
;system.multicore COREJTAGPORT 0
;system.config MEMORYACCESSPORT 0

system.config AXIACCESSPORT   0.
system.config DEBUGACCESSPORT 1
system.config APBACCESSPORT   1.
system.config AHBACCESSPORT   3.
sys.MemAccess.dap
&CUR_DIR=OS.PPD()
;DO &CUR_DIR/iSharkl2_JTAG.cmm "&CONFIG_INPUT"
DO &CUR_DIR/iSharkl2_JTAG.cmm "DAP"

;IF (&slave_flag==False())
;(
	;SYStem.CONFIG.Slave OFF
;)
on error CONTINUE 
SYStem.Mode.Prepare	
&temp=STRing.SCAN("&core_flags", "DAP", 0)
IF &temp!=-1
(
	ENDDO
)
if ("&sys_sel"=="small_sys")
(
	DO &CUR_DIR\dap_release_r5_cm4.cmm CR5
	wait 1.s
	sys.Mode.Attach
	Break
	DO &CUR_DIR\cp_mpu_init.cmm
	;DO &CUR_DIR\R5_release_DSP.cmm
)
ELSE if ("&sys_sel"=="os_sys")
(
	sys.Mode.Attach
	;Break
)
ENDDO


