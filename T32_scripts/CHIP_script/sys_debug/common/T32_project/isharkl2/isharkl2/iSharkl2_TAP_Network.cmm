GLOBAL &BIA_b_ops &BIA_IDCODE &DAP_b_ops &FUSE_b_ops
GLOBAL &BIA_P_BIT &DAP_P_BIT &FUSE_P_BIT

;CUSTOM IDCODE:0x53505225, or BIA IDCODE: 0x4e783013
&BIA_IDCODE=0x4e783013
&BIA_b_ops="pTAP"
&DAP_b_ops="biaTAP"
&FUSE_b_ops="dapTAP"
&BIA_P_BIT=(1<<0.)
&DAP_P_BIT=(1<<1.)
&FUSE_P_BIT=(1<<2.)
ENDDO


