LOCAL &cmd &op1 &op2 &op3 &op4 &op5 &op6 &op7 &op8 &op9 &op0 &CUR_DIR
ENTRY &cmd &op1 &op2 &op3 &op4 &op5 &op6 &op7 &op8 &op9 &op0
&temp=OS.PPD()
&CUR_DIR="&temp"
IF "X&cmd"=="Xper"
(
	&cmd "&CUR_DIR/&op1" &op2 &op3 &op4 &op5 &op6 &op7 &op8 &op9 &op0
)

ENDDO