LOCAL &mem_type &set &clr &temp
ENTRY &mem_type
IF "X&mem_type"=="X"
	&mem_type="EZAXI"
&set=0x1000
&clr=0x2000

D.S &mem_type:0xe6000200 %LE %Quad 0xFFFFFFFBE9 

;tap_powergood_i
D.S &mem_type:(0xE42C0000+&set) %LE %LONG (1<<21.)
;cpu_powergood_i
D.S &mem_type:(0xE42C0000+&set) %LE %LONG (1<<22.)

;pad_out_dcdccpu1_frc_on
D.S &mem_type:(0xE42C0030+&set) %LE %LONG (1<<3.)
&temp=DATA.LONG(&mem_type:0xE42C0030)
IF (&temp&(1<<3.))==0
	PRINT %ERROR "DAP work around failed!"

;mask_mode
D.S &mem_type:(0xE4270000+&set) %LE %LONG (1<<5.)
&temp=DATA.LONG(&mem_type:0xE4270000)
IF (&temp&(1<<5.))==0
	PRINT %ERROR "DAP work around failed!"

;tap_powergood_i
D.S &mem_type:(0xE42C0000+&clr) %LE %LONG (1<<21.)
;cpu_powergood_i
D.S &mem_type:(0xE42C0000+&clr) %LE %LONG (1<<22.)

