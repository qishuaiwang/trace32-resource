	SYStem.Mode Prepare
	SYStem.Mode Down
	globalon POWERUP 
	enddo