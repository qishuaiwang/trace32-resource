LOCAL &os_sel 
ENTRY &os_sel 

system.mode down
system.reset

system.jtagclock 5Mhz

system.cpu CORTEXA53 
system.config CORENUMBER 1.
core.assign 1

sys.config corebase 0x81410000
SYS.CONFIG.CTIBase  0x81420000
sys.config.bmc.base 0x81430000
sys.config.etm.base 0x81440000

;system.multiCore JTAGACCESSPORT 0
;system.multicore COREJTAGPORT 0
system.config MEMORYACCESSPORT 0
system.config AXIACCESSPORT   0
system.config ApbACCESSPORT   1.
system.config DEBUGACCESSPORT 1
system.config SWDP ON
;system.mode Prepare
if ("&os_sel"=="small_sys")
(
	system.mode attach
	Break
)
ELSE IF ("&os_sel"=="os_sys")
(
	print "this is os_sys.if core debug, please system.mode attach"
)
ENDDO