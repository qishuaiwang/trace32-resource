LOCAL &flag
ENTRY &flag

if ("&flag"=="")
(
	&flag=0x0
)
if (&flag==0x1)
(
	sys.m.a
	break
)
if (&flag==0x2)
(
	break
)
ENDDO