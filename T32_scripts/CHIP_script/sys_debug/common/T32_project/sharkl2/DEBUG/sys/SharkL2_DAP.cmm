SYStem.CONFIG.SWDP ON
SYStem.CONFIG AHBACCESSPORT 0xff
SYStem.CONFIG AXIACCESSPORT 0.

