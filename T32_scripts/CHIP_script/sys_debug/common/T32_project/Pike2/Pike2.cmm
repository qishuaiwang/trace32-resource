;---------------------------------------------------------------------------------------
; Menu reprogram, add customized bottons and menus
;---------------------------------------------------------------------------------------
GLOBAL &g_proj_dir &os_sel
LOCAL &sys_script
LOCAL &debug &TAP_SEL &sel_flag
ENTRY &os_sel
;PLIST
;STOP
LOCAL &temp

&temp=OS.PPD()
&g_proj_dir="&temp"

IF "X&os_sel"=="X"
(
	&os_sel="small_sys"
)


GLOBALON CMD menuedit do "&g_proj_dir/EDIT_CMM.cmm"
GLOBALON CMD menusrst do "&g_proj_dir/jtag_SRST.cmm"
GLOBALON CMD menuap do "&g_proj_dir/A7.cmm"
GLOBALON CMD menupcp do "&g_proj_dir/R5.cmm"
GLOBALON CMD menusp do "&g_proj_dir/CM4.cmm"
GLOBALON CMD menutg do "&g_proj_dir/TGDSP_TL420.cmm"
GLOBALON CMD menuddr DO "&g_proj_dir/DDR.cmm"
GLOBALON CMD menudsp DO "&g_proj_dir/boot_dsp.cmm"
;GLOBALON CMD menucheck DO "&g_proj_dir/Check_Power.cmm"

GLOBALON CMD menuab DO "&g_proj_dir/attach.cmm"
GLOBALON CMD menuchk DO "&g_proj_dir/DEBUG/sys/Per_Preload.cmm"
GLOBALON CMD menulod DO "&g_proj_dir/DEBUG/sys/cmd_load.cmm"
GLOBALON CMD menure DO "&g_main_path/main.cmm"
GLOBALON CMD menupy DO "&lib_do_Py"
GLOBALON CMD menudbg DO "&lib_debug_bus_cfg"
GLOBALON CMD menubma DO "&lib_busmon_eb_dis_all"
GLOBALON CMD menubmb DO "&lib_busmon_addr_cfg"
GLOBALON CMD menubmc DO "&lib_busmon_addr_scan"
GLOBALON CMD menubmd DO "&lib_busmon_reg_read"
GLOBALON CMD menulnx DO "&lib_setup_linux"

MENU.RESET
(&
    MENU.REPROGRAM
    (&
      ADD
      TOOLBAR
      (
			IF (CPUFAMILY()=="ARM")
			(
				TOOLITEM "AP A7 All Core" "AP,a" "menuap 4"
				TOOLITEM "A7 C0" "C0,b" "menuap 1 0"
				SEPARATOR
				TOOLITEM "PCP" "CP,a" "menupcp"
				TOOLITEM "SP" "SP,c" "menusp"
				TOOLITEM "GNSS" "GS,c" "menusp 5"
				TOOLITEM "WIFI" "WF,c" "menusp 4"
				SEPARATOR
				TOOLITEM "Attach_break" "AT,c" "menuab 0x1"
				TOOLITEM "Attach Break Go" "BG,c" "menuab 0x2"
				IF ("&os_sel"=="small_sys")
				(
					SEPARATOR
					TOOLITEM "Reset SYS" "RS,r" "menusrst"
					TOOLITEM "Init DDR" "DR,b" "menuddr"
					TOOLITEM "DSP" "DP,r" "menudsp"
				)
				SEPARATOR
				TOOLITEM "Check via EAXI" "CK,g" "menuchk EAXI"
				TOOLITEM "Check via EAHB" "CA,r" "menuchk EAHB"
				TOOLITEM "Check via CPU" "CC,b" "menuchk D"
				SEPARATOR
				TOOLITEM "Python" "PY,r" "menupy"
			)
			IF (CPUFAMILY()=="TEAKLITE4"||CPUFAMILY()=="OAK")
			(
				TOOLITEM "TGDSP" "TD,b" "menutg"
				SEPARATOR
				TOOLITEM "Attach_break" "AT,c" "menuab 0x1"
				TOOLITEM "Attach Break Go" "BG,c" "menuab 0x2"
				SEPARATOR
				TOOLITEM "Reset SYS" "RS,r" "menusrst"
			)
      )
    )
    MENU.ReProgram "&g_proj_dir/Pike2.men"
)
ENDDO
cancel:
  DIALOG.END
  ENDDO